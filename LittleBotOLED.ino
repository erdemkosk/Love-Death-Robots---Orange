#include <Wire.h>
#include <Adafruit_GFX.h>
#include <Adafruit_SSD1306.h>

Adafruit_SSD1306 display(128, 64, &Wire);

static const unsigned char pointy[] PROGMEM ={
0x60, 0x06, 0xf0, 0x0f, 0xf8, 0x1f, 0x7c, 0x3e, 0x3e, 0x7c, 0x1f, 0xf8, 0x0f, 0xf0, 0x07, 0xe0,
0x03, 0xc0, 0x01, 0x80,
};

static const unsigned char smile[] PROGMEM ={
0x00, 0x00, 0x00, 0x00, 0x00, 0x00, 0x00, 0x00, 0x00, 0x00, 0x00, 0x00, 0x00, 0x00, 0x00, 0x00, 
  0x00, 0x00, 0x00, 0x00, 0x00, 0x00, 0x00, 0x00, 0x00, 0x00, 0x00, 0x00, 0x00, 0x00, 0x00, 0x00, 
  0x00, 0x00, 0x00, 0x00, 0x00, 0x00, 0x00, 0x00, 0x00, 0x00, 0x00, 0x00, 0x00, 0x00, 0x00, 0x00, 
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  0x00, 0x00, 0x00, 0x00, 0x00, 0x00, 0x00, 0x00, 0x00, 0x00, 0x00, 0x00, 0x00, 0x00
};

static const unsigned char openMounth[] PROGMEM ={
0x00, 0x00, 0x00, 0x00, 0x00, 0x00, 0x00, 0x00, 0x00, 0x00, 0x00, 0x00, 0x00, 0x00, 0x00, 0x00, 
  0x00, 0x00, 0x00, 0x00, 0x00, 0x00, 0x00, 0x00, 0x00, 0x00, 0x00, 0x00, 0x00, 0x00, 0x00, 0x00, 
  0x00, 0x00, 0x00, 0x00, 0x00, 0x00, 0x00, 0x00, 0x00, 0x00, 0x00, 0x00, 0x00, 0x00, 0x00, 0x00, 
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  0x00, 0x00, 0x00, 0x00, 0x00, 0x00, 0x00, 0x00, 0x00, 0x00, 0x00, 0x00, 0x00, 0x00
};

static const unsigned char openMounthFlat[] PROGMEM ={
0x00, 0x00, 0x00, 0x00, 0x00, 0x00, 0x00, 0x00, 0x00, 0x00, 0x00, 0x00, 0x00, 0x00, 0x00, 0x00, 
  0x00, 0x00, 0x00, 0x00, 0x00, 0x00, 0x00, 0x00, 0x00, 0x00, 0x00, 0x00, 0x00, 0x00, 0x00, 0x00, 
  0x00, 0x00, 0x00, 0x00, 0x00, 0x00, 0x00, 0x00, 0x00, 0x00, 0x00, 0x00, 0x00, 0x00, 0x00, 0x00, 
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  0x00, 0x00, 0x00, 0x00, 0x00, 0x00, 0x00, 0x00, 0x00, 0x00, 0x00, 0x00, 0x00, 0x00
};

void setup() {

  display.begin(SSD1306_SWITCHCAPVCC, 0x3c); // initialize with the I2C addr 0x3D (for the 128x64)

  display.clearDisplay();
  display.setTextColor(WHITE);
  display.setTextSize(3);

  display.setRotation(2);// Rotate the display at the start:  0, 1, 2 or 3 = (0, 90, 180 or 270 degrees)
  display.clearDisplay();
}


void loop() {

  boing();
  boing();
  boing();
  boing();
     
 
  drawOpeneyes(22, 26);
  delay(1000);

  drawClosedyes(22);
  delay(50);

  drawOpeneyes(22, 26);
  delay(1000);

  drawClosedyes(22);
  delay(50);

  drawLookLeft(22, 26);
  delay(1000);

  drawClosedyes(22);
  delay(50);

  drawLookRight(22, 26);
  delay(1000);

  drawClosedyes(22);
  delay(50);

  drawSmile(22,26);
   delay(1000);

  drawSmileClosed(22);
  delay(50);

  drawSmile(22,26);
   delay(1000);

  drawSmileClosed(22);
  delay(50);

  drawSmile(22,26);
   delay(1000);

  drawSmileClosed(22);
  delay(50);

   drawSmile(22,26);
   delay(1000);

  drawSmileClosed(22);
  delay(50);

  drawOpenMounth(15, 18);
  delay(1000);

  drawOpenMounthFlat(15, 18);
  delay(1000);

    drawNarrowMouth(16, 16);
  delay(1000);

}


void drawOpeneyes(int eyeWidth, int eyeHeight) {
  display.clearDisplay();
  display.fillRoundRect(0, 20, eyeWidth, eyeHeight, eyeWidth/2, WHITE);
  display.fillRoundRect(display.width()-eyeWidth, 20, eyeWidth, eyeHeight, eyeWidth/2, WHITE);
  display.fillRoundRect(display.width()/2-20, display.height()-10, 40, 10, 5, WHITE);
  display.display();
}

void drawLookLeft(int eyeWidth, int eyeHeight) {
  display.clearDisplay();
  display.fillRoundRect(0, 20, eyeWidth +5 , eyeHeight +5 , eyeWidth/2, WHITE);
  display.fillRoundRect(display.width()-eyeWidth, 20, eyeWidth -5 , eyeHeight -5, eyeWidth/2, WHITE);
  display.fillRoundRect(display.width()/2-20, display.height()-10, 40, 10, 5, WHITE);
  display.display();
}

void drawLookRight(int eyeWidth, int eyeHeight) {
  display.clearDisplay();
  display.fillRoundRect(0, 20, eyeWidth -5 , eyeHeight -5 , eyeWidth/2, WHITE);
  display.fillRoundRect(display.width()-eyeWidth, 20, eyeWidth, eyeHeight , eyeWidth/2, WHITE);
  display.fillRoundRect(display.width()/2-20, display.height()-10, 40, 10, 5, WHITE);
  display.display();
}

void drawSmile(int eyeWidth, int eyeHeight) {
  display.clearDisplay();
  display.fillRoundRect(0, 20, eyeWidth, eyeHeight, eyeWidth/2, WHITE);
  display.fillRoundRect(display.width()-eyeWidth, 20, eyeWidth, eyeHeight, eyeWidth/2, WHITE);
  display.drawBitmap(display.width()/2-25, display.height()-40, smile, 50, 50, WHITE);
  display.display();
}

void drawSmileClosed(int eyeWidth) {
  display.clearDisplay();
 display.fillRoundRect(0, 28, eyeWidth, 6, 3, WHITE);
  display.fillRoundRect(display.width()-eyeWidth, 28, eyeWidth, 6, 3, WHITE);
  display.drawBitmap(display.width()/2-25, display.height()-40, smile, 50, 50, WHITE);
  display.display();
}


void drawOpenMounth(int eyeWidth, int eyeHeight) {
  display.clearDisplay();
  display.fillRoundRect(0, 20, eyeWidth, eyeHeight, eyeWidth/2, WHITE);
  display.fillRoundRect(display.width()-eyeWidth, 20, eyeWidth, eyeHeight, eyeWidth/2, WHITE);
  display.drawBitmap(display.width()/2-25, display.height()-40, openMounth, 50, 50, WHITE);
  display.display();
}

void drawOpenMounthFlat(int eyeWidth, int eyeHeight) {
  display.clearDisplay();
  display.fillRoundRect(eyeWidth, 20, eyeWidth, eyeHeight, eyeWidth/2, WHITE);
  display.fillRoundRect(display.width()-eyeWidth*2, 20, eyeWidth, eyeHeight, eyeWidth/2, WHITE);
  display.drawBitmap(display.width()/2-25, display.height()-40, openMounthFlat, 50, 50, WHITE);
  display.display();
}

void drawClosedyes(int eyeWidth) {  
  display.clearDisplay();
  display.fillRoundRect(0, 28, eyeWidth, 6, 3, WHITE);
  display.fillRoundRect(display.width()-eyeWidth, 28, eyeWidth, 6, 3, WHITE);
  display.fillRoundRect(display.width()/2-20, display.height()-10, 40, 10, 5, WHITE);
  display.display();
}

void drawNarrowMouth(int eyeWidth, int eyeHeight) {  
  display.clearDisplay();
  display.fillRoundRect(0, 20, eyeWidth, eyeHeight, eyeWidth/2, WHITE);
  display.fillRoundRect(display.width()-eyeWidth, 20, eyeWidth, eyeHeight, eyeWidth/2, WHITE);
  display.fillRoundRect(display.width()/2-35, display.height()-10, 70, 10, 5, WHITE);
  display.display();
}

void boing() {
  int eyeWidth = 22, eyeHeight = 26, animSpeed = 4, eyeStretch = 10;
  
  int eyePosY;


  for(int i = -eyeStretch ; i <= 50-26; i+=animSpeed){
    eyePosY = max(i, 0);
    
    display.clearDisplay();
    display.fillRoundRect(0, eyePosY, eyeWidth, eyeHeight, eyeWidth/2, WHITE);
    display.fillRoundRect(display.width()-eyeWidth, eyePosY, eyeWidth, eyeHeight, eyeWidth/2, WHITE);
    display.drawBitmap(display.width()/2-8, display.height()-20, pointy, 16, 10, WHITE);
    display.display();
    

    if(i>=64-eyeWidth-eyeStretch) eyeHeight -= animSpeed;
    else if(i<0) eyeHeight += animSpeed;
  }

  
  for(int i = 50-26; i > -eyeStretch; i-=animSpeed){
    eyePosY = max(i, 0);

    display.clearDisplay();
    display.fillRoundRect(0, eyePosY, eyeWidth, eyeHeight, eyeWidth/2, WHITE);
    display.fillRoundRect(display.width()-eyeWidth, eyePosY, eyeWidth, eyeHeight, eyeWidth/2, WHITE);
    display.drawBitmap(display.width()/2-8, display.height()-20, pointy, 16, 10, WHITE);
    display.display();
    

    if(i>64-eyeWidth-eyeStretch) eyeHeight += animSpeed;
    else if(i<=0) eyeHeight -= animSpeed;
  }
  
}
